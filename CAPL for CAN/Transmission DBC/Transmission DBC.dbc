VERSION "created by canmatrix"

NS_ :

BS_:

BU_:

BO_ 260 VehicleMotion: 8 Vector__XXX
 SG_ EngineRunning : 1|1@1+ (1,0) [0|1] "" Vector__XXX
 SG_ Velocity : 8|16@1+ (0.1,0) [0|65535] "km/h" Vector__XXX

BO_ 261 BrakeMsg: 8 Vector__XXX
 SG_ BrakeStatus : 0|1@1+ (1,0) [0|1] "" Vector__XXX

BO_ 262 AccelarationMsg: 8 Vector__XXX
 SG_ Acceleration : 0|16@1+ (0.1,0) [0|65535] "m/s2" Vector__XXX

CM_ SG_ 260 EngineRunning "Echos Engine Running Status";
CM_ SG_ 260 Velocity "Value of the Vehicles Velocity";
CM_ SG_ 261 BrakeStatus "Status of wether Brake is applied or not";
CM_ SG_ 262 Acceleration "Value of the Acceleration Applaid";
VAL_ 260 EngineRunning 0 "NotRunning" 1 "Running" ;
VAL_ 261 BrakeStatus 0 "BrakeNotApplied" 1 "BrakeApplied" ;
